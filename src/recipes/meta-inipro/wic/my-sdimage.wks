## src/recipes/meta-inipro/wic/my-sdimage.wks
```
# short-description: Create SD card image with a boot partition
# long-description: Creates a partitioned SD card image. Boot files
# are located in the first vfat partition.

part /media/card --source bootimg-partition --ondisk mmcblk0 --fstype=vfat --label card --active --align 4 --size 800
part / --source rootfs --ondisk mmcblk0 --fstype=ext4 --label root --align 4 --extra-space 2400
```
